## configs/core/pislide/buildroot_ext/package/rayimg/Config.in
```kconfig
config BR2_PACKAGE_RAYIMG
	bool "rayimg"
	depends on BR2_PACKAGE_LIBVIPS_MESON
	depends on BR2_PACKAGE_LUA_VIPS
	depends on BR2_PACKAGE_LIBRAYLIB
	depends on BR2_PACKAGE_LIBVIPS_MESON
	depends on BR2_PACKAGE_LUAJIT
	help
	  Build the binary rayimg
```
