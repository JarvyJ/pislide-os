## configs/core/pislide/buildroot_ext/Config.in
```kconfig
source "$BR2_EXTERNAL_RAYIMG_PATH/package/libraylib/Config.in"
source "$BR2_EXTERNAL_RAYIMG_PATH/package/libvips-meson/Config.in"
source "$BR2_EXTERNAL_RAYIMG_PATH/package/lua-lpath/Config.in"
source "$BR2_EXTERNAL_RAYIMG_PATH/package/lua-rayimg/Config.in"
source "$BR2_EXTERNAL_RAYIMG_PATH/package/lua-vips/Config.in"
```

## configs/core/pislide/buildroot_ext/package/libraylib/Config.in
```kconfig
config BR2_PACKAGE_LIBRAYLIB
	bool "libraylib"
	depends on BR2_PACKAGE_HAS_LIBGLES
	depends on BR2_PACKAGE_HAS_LIBEGL
	depends on BR2_PACKAGE_HAS_LIBGBM
	depends on BR2_PACKAGE_LIBDRM
	help
	  libraylib - A simple and easy-to-use library to enjoy videogames programming 

	  http://www.raylib.com
```

## configs/core/pislide/buildroot_ext/package/lua-lpath/Config.in
```kconfig
config BR2_PACKAGE_LUA_LPATH
	bool "lua-lpath"
	select BR2_PACKAGE_LUA_LPATH
	help
	  a OS specified path manipulation module for Lua

	  https://github.com/starwing/lpath/tree
```

## configs/core/pislide/buildroot_ext/package/lua-rayimg/Config.in
```kconfig
config BR2_PACKAGE_LUA_RAYIMG
	bool "lua-rayimg"
	depends on BR2_PACKAGE_LUAJIT
	depends on BR2_PACKAGE_LIBVIPS_MESON
	depends on BR2_PACKAGE_LUA_VIPS
	depends on BR2_PACKAGE_LUA_LPATH
	depends on BR2_PACKAGE_LIBRAYLIB
	
	help
	  Build the binary rayimg
```

## configs/core/pislide/buildroot_ext/package/lua-vips/Config.in
```kconfig
config BR2_PACKAGE_LUA_VIPS
	bool "lua-vips"
	depends on BR2_PACKAGE_LIBVIPS_MESON
	help
	  Lua binding for the libvips image processing library 

	  https://github.com/libvips/lua-vips
```

## configs/core/pislide/buildroot_ext/package/pislideapi/Config.in
```kconfig
config BR2_PACKAGE_PISLIDEAPI
	bool "pislideapi"
	depends on BR2_PACKAGE_HOST_GO_TARGET_ARCH_SUPPORTS
	depends on BR2_PACKAGE_HOST_GO_TARGET_CGO_LINKING_SUPPORTS
	depends on BR2_TOOLCHAIN_HAS_THREADS
	depends on BR2_PACKAGE_LIBVIPS_MESON
	help
	  Build the pislideapi
```
